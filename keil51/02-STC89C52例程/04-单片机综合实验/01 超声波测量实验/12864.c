/***************************************************************************
实验名称： 超声波测量实验

实验模块:  51单片机核心板、液晶显示区（12864）、超声波传感器模块

实验接线：	51单片机核心板------超声波传感器模块				
					 P3,2--------------IN
					 P3,3--------------OUT
			51单片机核心板------液晶显示区（1602字符液晶）
					 P2.0--------------CS1
					 P2.1--------------CS2
					 P2.2--------------CS
					 P2.3--------------RW
					 P2.4--------------E
				P0.0~P0.7--------------DB0~DB7		
						
现象描述：	12864显示距离值

更新时间：	2017.10.22
***************************************************************************/
#define uchar unsigned char
#define uint  unsigned int


sbit LCD_E = P2^4;			//定义管脚
sbit LCD_RW = P2^3;
sbit LCD_RS = P2^2;
sbit LCD_CS2 = P2^1;
sbit LCD_CS1 = P2^0;
#define  Data_Port P0

uchar code Dot[][32] =        // 数据表
{

//-- 超 --
      {0x40,0x48,0x48,0xFF,0x48,0x48,0x82,0x42,0x3E,0x02,0x22,0x42,0x3F,0x02,0x00,0x00,
      0xC0,0xBF,0x90,0x9F,0xA2,0xC2,0xC0,0xDF,0xD1,0xD1,0xD1,0xD1,0xDF,0xE0,0xA0,0x80},
//-- 声 --
      {0x04,0x14,0xD4,0x54,0x54,0x54,0x54,0xDF,0x54,0x54,0x54,0x54,0xF4,0x56,0x04,0x00,
      0x80,0xE0,0x9F,0x82,0x82,0x82,0x82,0x83,0x82,0x82,0x82,0x82,0x87,0x80,0x80,0x80},
//-- 波 --
      {0x20,0x42,0x04,0x0C,0x80,0xF8,0x88,0x88,0x88,0xFF,0x88,0x88,0xA8,0x18,0x00,0x00,
      0x84,0x84,0xFE,0xC1,0xB0,0x8F,0xC0,0xA2,0x94,0x88,0x94,0xA2,0xC1,0xC0,0xC0,0x80},
//-- 测 --
      {0x10,0x22,0x6C,0x00,0x80,0xFC,0x04,0xF4,0x04,0xFE,0x04,0xF8,0x00,0xFE,0x00,0x00,
      0x84,0x84,0xFE,0x81,0xC0,0xA7,0x90,0x8F,0x90,0xE7,0x80,0xC7,0x80,0xFF,0x80,0x80},
//-- 距 --
      {0x00,0x3E,0x22,0xE2,0x22,0x3E,0x00,0xFE,0x22,0x22,0x22,0x22,0xF3,0x22,0x00,0x00,
      0xA0,0xFF,0xA0,0xBF,0x92,0x92,0x80,0xFF,0xC2,0xC2,0xC2,0xC2,0xC7,0xE0,0xC0,0x80},
//-- 距 --
      {0x00,0x3E,0x22,0xE2,0x22,0x3E,0x00,0xFE,0x22,0x22,0x22,0x22,0xF3,0x22,0x00,0x00,
      0xA0,0xFF,0xA0,0xBF,0x92,0x92,0x80,0xFF,0xC2,0xC2,0xC2,0xC2,0xC7,0xE0,0xC0,0x80},
//-- 离 --
      {0x04,0x04,0x04,0xF4,0x04,0x8C,0x55,0x26,0x54,0x8C,0x04,0xF4,0x04,0x06,0x04,0x00,
      0x80,0xFC,0x84,0x85,0xA5,0xB5,0xAD,0xA7,0xA5,0xB5,0xA5,0xC5,0x84,0xFE,0x84,0x80}
};


uchar code num[][16] =              // ASCII
{

	{0xF8,0xFC,0x04,0xC4,0x24,0xFC,0xF8,0x00,0x87,0x8F,0x89,0x88,0x88,0x8F,0x87,0x80}, // -0-

	{0x00,0x10,0x18,0xFC,0xFC,0x00,0x00,0x00,0x80,0x88,0x88,0x8F,0x8F,0x88,0x88,0x80}, // -1-
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	{0xE0,0xE0,0x60,0xC0,0x60,0xE0,0xC0,0x00,0x8F,0x8F,0x80,0x8F,0x80,0x8F,0x8F,0x80}  // -m-
};

/*-------------------------------------------------------
函数名称: Write_Com()
函数功能: 向LCD12864里写命令
参数    : left  左边芯片选通位
right 右边芯片选通位
Com  要写的命令
返回值  : 无
---------------------------------------------------------*/
void Write_Com(uchar com)
{

	LCD_E=0;
	LCD_RS=0;
	LCD_E=1; 
	Data_Port=com;  
}
/*-------------------------------------------------------
函数名称: Write_Data()
函数功能: 向LCD12864里写数据
参数    : left  左边芯片选通位
right 右边芯片选通位
Data  要写的数据
返回值  : 无
---------------------------------------------------------*/
void Write_Data(uchar Data)
{

	LCD_E=0;
	LCD_RS=1;
	LCD_E=1;
	Data_Port=Data;  
}
/*-----------------------------------------
函数名称: LCD12864_Disp()
函数功能: 在任意位置上显示汉字
参数    : X X地址位置 
Y Y地址位置 
*P 指针 数据的首地址
返回值  : 无
------------------------------------------*/
void LCD12864_Disp(uchar x, uchar y, uchar *p )
{
	uchar i,j;
	char k;

	for(i=0;i<32;i++)
	{
		if(i>=16)
		{
			j=1;
			k=-16;
		}
		else j=0,k=0;
		Write_Com(0xb8+j+x);     //设置X地址
		Write_Com(0x40+i+y+k);   //设置Y地址
		Write_Data(p[i]);        //送数据
	}

}
/*-----------------------------------------
函数名称: LCD12864_DispNum()
函数功能: 在任意位置上显示数字
参数    : X X地址位置 
Y Y地址位置 
*P 指针 数据的首地址
返回值  : 无
------------------------------------------*/
void LCD12864_DispNum(uchar x, uchar y, uchar *p )
{
	uchar i,j;
	char k;
	for(i=0;i<16;i++)
	{    
		if(i>=8)
		{
		j=1;
		k=-8;
		}
		else j=0,k=0;
		Write_Com(0xb8+x+j); //设置X地址
		Write_Com(0x40+i+y+k);//设置Y地址
		Write_Data(p[i]);//送数据
	}
}
/*-------------------------------------------------------
函数名称: LCD12864_Init()
函数功能: LCD12864初始化
参数    : 
返回值  : 无
---------------------------------------------------------*/
void LCD12864_Init()
{
	Data_Port=0xFF;
	LCD_CS1=0;
	LCD_CS2=0;
	LCD_E=1;
	LCD_RW=0;
	Write_Com(0x3e);//显示关
	Write_Com(0x3f);//显示开
	Write_Com(0xc0);//显示起始行
	Write_Com(0xb8);//设置X地址
	Write_Com(0x40);//设置Y地址	、
	

}
/*---------------------------------------------------
函数名称: LCD12864_Clear()
函数功能: 清屏
参数    : left  清左屏
right 清右屏
返回值  ：无
【说明】 : 0 0  不清屏  11  清全屏
0 1  清右屏  10  清左屏
-----------------------------------------------------*/
void LCD12864_Clear()
{
	uchar aa,bb;//aa控制X地址 bb控制Y地址

		for(aa=0;aa<8;aa++)
		{
			Write_Com(0xb8+aa);
			LCD_CS1=0;
			LCD_CS2=1;
			for(bb=0;bb<64;bb++)
			{
				Write_Data(0x00);
			}
			LCD_CS1=1;
			LCD_CS2=0;
			for(bb=0;bb<64;bb++)
			{

				Write_Data(0x00);
			} 
		}
 
}
 void Display()
{
	LCD_CS1=0;
	LCD_CS2=1;
	LCD12864_Disp(1,16,Dot[0]);                
	LCD12864_Disp(1,32,Dot[1]);                
	LCD12864_Disp(1,48,Dot[2]);
	LCD_CS1=1;
	LCD_CS2=0;	                
	LCD12864_Disp(1,0,Dot[3]);                  
	LCD12864_Disp(1,16,Dot[4]);
	LCD_CS1=0;
	LCD_CS2=1;
	LCD12864_Disp(4,24,Dot[5]);                
	LCD12864_Disp(4,40,Dot[6]);
	LCD12864_DispNum(4,56,num[10]);
	LCD_CS1=1;
	LCD_CS2=0;	                
	LCD12864_DispNum(4,24,num[11]);
	LCD12864_DispNum(4,40,num[12]);                
	LCD12864_DispNum(4,48,num[12]);

}
void display(float dis2)
{
	uint dis,a,b,c,d;
	dis = (uint)dis2;
	a = dis/1000;
	b = dis/100%10;
	c = dis/10%10;
	d = dis%10;
	LCD_CS1=1;
	LCD_CS2=0;	                
	LCD12864_DispNum(4,0,num[a]);
	LCD12864_DispNum(4,8,num[b]);                
	LCD12864_DispNum(4,16,num[c]);
	LCD12864_DispNum(4,32,num[d]);
}

   
