/***************************************************************************
实验名称： 	RS485通信实验

实验模块:  	51单片机核心板

实验接线：  51单片机核心板 --------- 串行通信区
					P1.0 ------------ R/D
					P3.0 ------------ RXD
					P3.1 ------------ TXD

现象描述：	在串口调试助手中接收到单片机发送的数据

更新时间：	2017.10.17
***************************************************************************/


#include <reg51.h>

sbit RO_DE=P1^0;
#define COUNT 10                   // 定义接收缓冲区大小 

char code str[] = "Welcome! RS485 test program is runing!";

//---------------------------------------------------------------
// 函数名称： UART_init()串口初始化函数
// 函数功能： 在系统时钟为11.0592MHZ时，设定串口波特率为9600bit/s
//---------------------------------------------------------------
void UART_init()
{
    //初始化串行设置
	TMOD = 0x20;		// 定时器1工作于8位自动重载模式, 用于产生波特率
	TH1 = 0xFD;			// 波特率9600
	TL1 = 0xFD;	
	SCON = 0x50;		// 设定串行口工作方式
	PCON &= 0xef;		// 波特率不倍增		
	TR1 = 1;			// 启动定时器1
	IE = 0x0;			// 禁止任何中断
}

void Delay()
{
    unsigned char j;
    for(j=2000;j>0;j--);
}

//---------------------------------------------------------------
// 函数名称： COM_send()串口发送函数
// 函数功能： 把数据缓冲区的十位数据发送出去
//---------------------------------------------------------------
void send_char(unsigned char txd)
// 传送一个字符
{
   RO_DE=1;                	//设置MAX485进入发送状态
	SBUF = txd;
	while(!TI);				// 等待数据传送
	TI = 0;					// 清除数据传送标志
}

void send_str()
// 传送字串
{
	unsigned char i = 0;
   RO_DE=1;               		//设置MAX485进入发送状态
	while(str[i] != '\0')
	{
		SBUF = str[i];
		while(!TI);				// 等特数据传送
		TI = 0;					// 清除数据传送标志
		i++;					// 下一个字符
	}	
}

//---------------------------------------------------------------
// 函数名称： system_init()系统初始化
// 函数功能： 调用串口、定时器初始化函数，完成系统初始化
//---------------------------------------------------------------
void system_init(void)
{
    //系统总设置
    UART_init();
    EA =1;                //单片机中断允许
}

//---------------------------------------------------------------
// 函数名称： 主函数
// 函数功能： 调度个子函数，完成通信过程
//---------------------------------------------------------------
void main(void)
{
    unsigned char i=0;
    system_init();		   //系统初始化
    while(1)
       {
          send_str();
          Delay();
       }
}